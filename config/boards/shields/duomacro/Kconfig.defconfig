## config/boards/shields/duomacro/Kconfig.defconfig
```kconfig
if SHIELD_DUOMACRO_LEFT

config ZMK_KEYBOARD_NAME
    default "duomacro"

config ZMK_SPLIT_ROLE_CENTRAL
    default y

endif


if SHIELD_DUOMACRO_LEFT || SHIELD_DUOMACRO_RIGHT

config ZMK_SPLIT
    default y

endif
```

## config/boards/shields/duomacro/Kconfig.shield
```kconfig
config SHIELD_DUOMACRO_LEFT
    def_bool $(shields_list_contains,duomacro_left)

config SHIELD_DUOMACRO_RIGHT
    def_bool $(shields_list_contains,duomacro_right)
```
